CBLOCK

ENDC

;**************************************
;**************************************
;**************************************

_ENVIARCOMANDO
		MOVWF 	PORTB
		BCF 	PORTA,4
		BSF 	PORTA,3
		CALL 	_10MS
		BCF 	PORTA,3
RETURN

_ENVIARLETRA
		MOVWF 	PORTB
		BSF 	PORTA,4
		BSF 	PORTA,3
		CALL	_10MS
		BCF 	PORTA,3
RETURN

;******************************************
;********************************************
_M_LCD		
		CALL	_40MS
		MOVLW 	0X30			 ;INICIALIZACION
		CALL 	_ENVIARCOMANDO
		MOVLW 	0X33 			;NUMERO DE LINEAS Y CARACTERESA MOSTRAR
		CALL 	_ENVIARCOMANDO
		MOVLW 	0X08 			;APAGA EL DISPLAY
		CALL 	_ENVIARCOMANDO
		MOVLW 	0X01 			;LIMPIA EL DISPLAY
		CALL 	_ENVIARCOMANDO
		MOVLW	 0X03
		CALL 	_ENVIARCOMANDO
		MOVLW 	0X0E
		CALL 	_ENVIARCOMANDO

;***************************************
;**********CONFIGURACсN LCD*************
;***************************************
		MOVLW	d'20'
		CALL 	_ENVIARLETRA
		MOVLW	d'20'
		CALL 	_ENVIARLETRA
		MOVLW	d'20'
		CALL 	_ENVIARLETRA
		MOVLW	d'20'
		CALL 	_ENVIARLETRA
		MOVLW	d'20'
		CALL 	_ENVIARLETRA
		MOVLW	d'20'
		CALL 	_ENVIARLETRA
		CALL	_NUM
		MOVLW	d'20'
		CALL 	_ENVIARLETRA
		MOVLW	'C'
		CALL 	_ENVIARLETRA
		MOVLW	'M'
		CALL 	_ENVIARLETRA
RETURN

_NUM
		MOVLW	d'2'
		SUBWF	CONT,W
		BTFSC	STATUS,0
		GOTO	_ES_2
		MOVLW	'1'
		CALL	_ENVIARLETRA
		RETURN
		
_ES_2
		MOVLW	d'3'
		SUBWF	CONT,W
		BTFSC	STATUS,0
		GOTO	_ES_3
		MOVLW	'2'
		CALL	_ENVIARLETRA
		RETURN
		
_ES_3
		MOVLW	d'4'
		SUBWF	CONT,W
		BTFSC	STATUS,0
		GOTO	_ES_4
		MOVLW	'3'
		CALL	_ENVIARLETRA
		RETURN
		
_ES_4
		MOVLW	d'5'
		SUBWF	CONT,W
		BTFSC	STATUS,0
		GOTO	_ES_5
		MOVLW	'4'
		CALL	_ENVIARLETRA
		RETURN
		
_ES_5
		MOVLW	d'6'
		SUBWF	CONT,W
		BTFSC	STATUS,0
		GOTO	_ES_6
		MOVLW	'5'
		CALL	_ENVIARLETRA
		RETURN
		
_ES_6
		MOVLW	d'7'
		SUBWF	CONT,W
		BTFSC	STATUS,0
		GOTO	_ES_7
		MOVLW	'6'
		CALL	_ENVIARLETRA
		RETURN
		
_ES_7
		MOVLW	d'8'
		SUBWF	CONT,W
		BTFSC	STATUS,0
		GOTO	_ES_8
		MOVLW	'7'
		CALL	_ENVIARLETRA
		RETURN
		
_ES_8
		MOVLW	d'9'
		SUBWF	CONT,W
		BTFSC	STATUS,0
		GOTO	_ES_9
		MOVLW	'8'
		CALL	_ENVIARLETRA
		RETURN
		
_ES_9
		MOVLW	d'10'
		SUBWF	CONT,W
		BTFSC	STATUS,0
		GOTO	_ES_10
		MOVLW	'9'
		CALL	_ENVIARLETRA
		RETURN
		
_ES_10
		MOVLW	d'11'
		SUBWF	CONT,W
		BTFSC	STATUS,0
		GOTO	_ES_11
		MOVLW	'1'
		CALL	_ENVIARLETRA
		MOVLW	'0'
		CALL	_ENVIARLETRA
		RETURN
		
_ES_11
		MOVLW	d'12'
		SUBWF	CONT,W
		BTFSC	STATUS,0
		GOTO	_ES_12
		MOVLW	'1'
		CALL	_ENVIARLETRA
		MOVLW	'1'
		CALL	_ENVIARLETRA
		RETURN

_ES_12
		MOVLW	d'13'
		SUBWF	CONT,W
		BTFSC	STATUS,0
		GOTO	_ES_13
		MOVLW	'1'
		CALL	_ENVIARLETRA
		MOVLW	'2'
		CALL	_ENVIARLETRA
		RETURN
		
_ES_13
		MOVLW	d'14'
		SUBWF	CONT,W
		BTFSC	STATUS,0
		GOTO	_ES_14
		MOVLW	'1'
		CALL	_ENVIARLETRA
		MOVLW	'3'
		CALL	_ENVIARLETRA
		RETURN
		
_ES_14
		MOVLW	d'15'
		SUBWF	CONT,W
		BTFSC	STATUS,0
		GOTO	_ES_15
		MOVLW	'1'
		CALL	_ENVIARLETRA
		MOVLW	'4'
		CALL	_ENVIARLETRA
		RETURN
		
_ES_15
		MOVLW	d'16'
		SUBWF	CONT,W
		BTFSC	STATUS,0
		GOTO	_ES_16
		MOVLW	'1'
		CALL	_ENVIARLETRA
		MOVLW	'5'
		CALL	_ENVIARLETRA
		RETURN
		
_ES_16
		MOVLW	d'17'
		SUBWF	CONT,W
		BTFSC	STATUS,0
		GOTO	_ES_17
		MOVLW	'1'
		CALL	_ENVIARLETRA
		MOVLW	'6'
		CALL	_ENVIARLETRA
		RETURN
		
_ES_17
		MOVLW	d'18'
		SUBWF	CONT,W
		BTFSC	STATUS,0
		GOTO	_ES_18
		MOVLW	'1'
		CALL	_ENVIARLETRA
		MOVLW	'7'
		CALL	_ENVIARLETRA
		RETURN
		
_ES_18
		MOVLW	d'19'
		SUBWF	CONT,W
		BTFSC	STATUS,0
		GOTO	_ES_19
		MOVLW	'1'
		CALL	_ENVIARLETRA
		MOVLW	'8'
		CALL	_ENVIARLETRA
		RETURN
		
_ES_19
		MOVLW	d'20'
		SUBWF	CONT,W
		BTFSC	STATUS,0
		GOTO	_ES_20
		MOVLW	'1'
		CALL	_ENVIARLETRA
		MOVLW	'9'
		CALL	_ENVIARLETRA
		RETURN
		
_ES_20
		MOVLW	d'21'
		SUBWF	CONT,W
		BTFSC	STATUS,0
		GOTO	_ES_21
		MOVLW	'2'
		CALL	_ENVIARLETRA
		MOVLW	'0'
		CALL	_ENVIARLETRA
		RETURN
		
_ES_21
		MOVLW	d'22'
		SUBWF	CONT,W
		BTFSC	STATUS,0
		GOTO	_ES_22
		MOVLW	'2'
		CALL	_ENVIARLETRA
		MOVLW	'1'
		CALL	_ENVIARLETRA
		RETURN
		
_ES_22
		MOVLW	d'23'
		SUBWF	CONT,W
		BTFSC	STATUS,0
		GOTO	_ES_23
		MOVLW	'2'
		CALL	_ENVIARLETRA
		MOVLW	'2'
		CALL	_ENVIARLETRA
		RETURN
		
_ES_23
		MOVLW	d'24'
		SUBWF	CONT,W
		BTFSC	STATUS,0
		GOTO	_ES_24
		MOVLW	'2'
		CALL	_ENVIARLETRA
		MOVLW	'3'
		CALL	_ENVIARLETRA
		RETURN
		
_ES_24
		MOVLW	d'25'
		SUBWF	CONT,W
		BTFSC	STATUS,0
		GOTO	_ES_25
		MOVLW	'2'
		CALL	_ENVIARLETRA
		MOVLW	'4'
		CALL	_ENVIARLETRA
		RETURN
		
_ES_25
		MOVLW	d'26'
		SUBWF	CONT,W
		BTFSC	STATUS,0
		MOVLW	'2'
		CALL	_ENVIARLETRA
		MOVLW	'5'
		CALL	_ENVIARLETRA
		RETURN
		

