;****************************************************
;*****************************************************
;			SUBRUTINAS PARA MOVIMIENTO
;TANTO DEL SERVO QUE MUEVE EL SENSOR COMO, EL CARRITO 
;*****************************************************
;*****************************************************
CBLOCK

ENDC
;*********************************************
;AQUÍ LOS MOTORES SE DETIENEN, EL SERVO MOTOR
;GIRA A LA IZQUIERDA Y LLAMA A MEDIR. SÍ LA 
;DISTANCIA ES MENOR A 10, LLAMA A GIRAR EL
;SERVO A LA DERECHA Y MEDIR SINO, POSICIONA EL
;SERVO AL CENTRO Y CARRITO GIRA A LA IZQUIERDA
;*********************************************
_M_OFF_SM_L

		BCF		PORTC,M1P1		;APAGA MOTOR1
		BCF		PORTC,M1P2
		BCF		PORTC,M2P1		;APAGA MOTOR2
		BCF		PORTC,M2P2

_M_OFF_SM_L1	
		MOVLW	d'10'
		MOVWF	0X40
AQUI
		BSF		PORTC,SM
		CALL	_IZQ
		BCF		PORTC,SM
		CALL	_TD
		DECFSZ	0X40
		GOTO	AQUI
		
		CALL	_300ML
		
		
		CALL	_MEDIR_1		;15 CM?
								;MIDE Y RETORNA
		BTFSC	STATUS,0		;CHECA EL CARRY
		CALL	_SM_R			;SI ES 1, LLAMA A MOVER EL SERVOMOTOR A LA DERECHA
		CALL	_SM_C_ML		;SI ES 0, LLAMA A MOVER EL SERVOMOTOR AL CENTRO Y MOVER EL CARRITO
								;A LA IZQUIERDA
RETURN

;*********************************************
;AQUÍ LOS MOTORES SE DETIENEN, EL SERVO MOTOR
;GIRA A LA DERECHA Y LLAMA A MEDIR. SI HAY UNA
;DISTANCIA MENOR A 10, LLAMA A PONER EL SERVO 
;AL CENTRO Y A RETROCEDER. SINO, LLAMA A PONER 
;EL SERVO AL CENTRO Y GIRAR EL CAARRITO A LA 
;DERECHA.
;*********************************************

_SM_R
		MOVLW	d'30'
		MOVWF	0X40
AQUI1
		BSF		PORTC,SM
		CALL	_DER
		BCF		PORTC,SM
		CALL	_TD
		DECFSZ	0X40
		GOTO	AQUI1
		
		CALL	_300ML
		
		;GOTO	COMIENZA
		CALL	_MEDIR_1		;MIDE 15 CM?
		
		BTFSC	STATUS,0		;CHECA EL CARRY
		CALL	_SM_C_RET		;SI ES 1, MUEVE EL SERVO AL CENTRO Y RETROCEDE POR 2 SEGUNDOS
		;GOTO	COMIENZA
		CALL	_SM_C_MR		;SI ES 0, MUEVE EL SERVO AL CENTRO Y MUEVE EL CARRITO A LA DERECHA
RETURN

;*********************************************
;AQUI EL SERVO GIRA AL CENTRO Y EL CARRITO GIRA 
;A LA DERECHA Y LLAMA A MEDIR
;*********************************************

_SM_C_MR
		MOVLW	d'5'
		MOVWF	0X40
AQUI2
		BSF		PORTC,SM
		CALL	_CENTRO
		BCF		PORTC,SM
		CALL	_TD
		DECFSZ	0X40
		GOTO	AQUI2
		
		CALL	_HACKER_IZQ		;POSICIONA EL SISTEMA HACKERMAN HACIA LA DERECHA
		CALL	RETROCEDER		;RETROCEDE POR 2.8 SEGUNDOS
		CALL	_HACKER_DER		;POSICIONA EL SISTEMA HACKERMAN A LA IZQUIERDA PARA QUE A ESE SENTIDO COMIENCE A GIRAR
	
		BCF		PORTC,M1P1		;MOTOR1 ON, Y MOTOR2 OFF. 
		BSF		PORTC,M1P2		;ESTO HARA QUE EL CARRITO SE 
		BCF		PORTC,M2P1		;POSICIONE DEL LADO DERECHO
		BSF		PORTC,M2P2		; :)

		CALL	_MOV
		BCF		PORTC,M1P2		;APAGA MOTOR1
		BCF		PORTC,M2P2		;DETIENE EL MOTOR
		CALL	_HACKER_CE_DER	;LLAMA A PONER ELSISTEMA HACKERMAN AL CENTRO

		GOTO	COMIENZA		;COMIENZA DE NUEVO EL PROGRAMA
RETURN

;*********************************************
;AQUÍ EL SERVO GIRA AL CENTRO Y EL CARRITO
;RETROCEDERA 
;*********************************************

_SM_C_RET
		
		MOVLW	d'5'
		MOVWF	0X40
AQUI3
		BSF		PORTC,SM
		CALL	_CENTRO
		BCF		PORTC,SM
		CALL	_TD
		DECFSZ	0X40
		GOTO	AQUI3
	
		CALL	RETROCEDER	
		;BSF		PORTC,M1P1		;MOTOR1 Y MOTOR2 GIRAN 
		;BCF		PORTC,M1P2		;EN SENTIDO CONTRARIO
		;BSF		PORTC,M2P1		
		;BCF		PORTC,M2P2
		;CALL	_RETRO			;RETROCEDE POR 5 SEGUNDOS
		
		CLRF	PORTC			;LIMPIA EL PUERTO C PARA QUE SE APAGUEN LOS MOTORES 
		CALL	_M_OFF_SM_L1	;LLAMA A VOLVER A GIRAR EL SERVO A LA IZQUIERDA
;(EN ESTE PUNTO VUELVE A COMENZAR LA LOGICA PERO EL CARRITO YA SE ENCUENTA EN OTRA POSICION)
RETURN

;*********************************************
;AQUÍ EL SERVO GIRA AL CENTRO Y EL CARRITO
;GIRA A LA DERECHA.
;*********************************************

_SM_C_ML
		
		MOVLW	d'5'
		MOVWF	0X40
AQUI4
		BSF		PORTC,SM		;EL SERVO SE
		CALL	_CENTRO			;POSICIONA AL
		BCF		PORTC,SM		;AL CENTRO
		CALL	_TD
		DECFSZ	0X40
		GOTO	AQUI4
		
		CALL	_HACKER_DER		;POSICIONA EL SISTEMA HACKERMAN HACIA LA DERECHA
		CALL	RETROCEDER		;RETROCEDE POR 2.8 SEGUNDOS
		CALL	_HACKER_IZQ		;POSICIONA EL SISTEMA HACKERMAN A LA IZQUIERDA PARA QUE A ESE SENTIDO COMIENCE A GIRAR
		
		BCF		PORTC,M1P1		;APAGA MOTOR1 OFF Y MOTOR2 ON
		BSF		PORTC,M1P2		;ESTO HARA QUE EL CARRITO SE 
		BCF		PORTC,M2P1		;POSICIONE DEL LADO IZQUIERDO
		BSF		PORTC,M2P2		; <3
		
		CALL	_MOV			;RETARDO DE 4 SEGUNDOS
			
		BCF		PORTC,M2P2			;DETIENE EL MOTOR
		BCF		PORTC,M1P2			;DETIENE EL MOTOR
		CALL	_HACKER_CE_IZQ		;LLAMA A PONER ELSISTEMA HACKERMAN AL CENTRO

		GOTO	COMIENZA		;COMIENZA DE NUEVO LA LOGICA DEL PROGRAMA
RETURN


;****************************************
;MOVIMIENTOS PARA EL HACKERMAN***********
;****************************************

_HACKER_MOV_INICIAL
		BSF		PORTA,0			;GIRA A LA DERECHA
		BCF		PORTA,1
		CALL	_HACK
		BCF		PORTA,0
		CALL	_RETRO	
		
		BCF		PORTA,0			;GIRA A LA IZQUIERDA
		BSF		PORTA,1
		CALL	_HACK
		BCF		PORTA,1
		CALL	_RETRO
		
		BSF		PORTA,0			;SE POSICIONA AL CENTRO
		BCF		PORTA,1
		CALL	_HACKCEN
		BCF		PORTA,0
		CALL	_RETRO
RETURN


_HACKER_DER
		BSF		PORTA,0			;GIRA A LA DERECHA
		BCF		PORTA,1
		CALL	_HACK
		BCF		PORTA,0
RETURN

_HACKER_IZQ
		BCF		PORTA,0			;GIRA A LA IZQUIERDA
		BSF		PORTA,1
		CALL	_HACK
		BCF		PORTA,1
RETURN

;****************************************************
;AL CENTRO VINIENDO DE LA DERECHA********************
;****************************************************
_HACKER_CE_DER
		BCF		PORTA,0			;SE POSICIONA AL CENTRO
		BSF		PORTA,1
		CALL	_HACKCEN
		BCF		PORTA,1
RETURN

;***************************************************
;AL CENTRO VINIENDO DE LA IZQUIERDA
_HACKER_CE_IZQ
		BSF		PORTA,0			;SE POSICIONA AL CENTRO
		BCF		PORTA,1
		CALL	_HACKCEN
		BCF		PORTA,0
RETURN

RETROCEDER
		BSF		PORTC,M1P1		;MOTOR1 Y MOTOR2 GIRAN 
		BCF		PORTC,M1P2		;EN SENTIDO CONTRARIO
		BSF		PORTC,M2P1		
		BCF		PORTC,M2P2
		CALL	_RETRO1			;RETROCEDE POR 2 SEGUNDOS
		BCF		PORTC,M1P1
		BCF		PORTC,M2P1
RETURN