;DECLARACIÓN DE BITS
TG		EQU		0X00	;TIGER PIN0
EC		EQU		0X01	;ECHO PIN1
M1P1	EQU		0X03	;MOTOR 1 PIN1_PH, PIN3_PIC
M1P2	EQU		0X04	;MOTOR 1 PIN2_PH, PIN4_PIC
M2P1	EQU		0X05	;MOTOR 2 PIN1_PH, PIN5_PIC	
M2P2	EQU		0X06	;MOTOR 2 PIN2_PH, PIN6_PIC
SM		EQU		0X02	;SALIDA PARA EL SERVOMOTOR PIN2_PIC
RP0		EQU		0X05
RP1		EQU		0X06
;E		EQU		0X03
;RS		EQU		0X04	
;DECLARACIÓN DE VARIABLES
DIS		EQU		0X30	;VARIAVLE PARA CONFIGURAR Y ESTAVLECER LA DISTANCIA
CONT	EQU		0X31	;CONTADOR PARA MEDIR LA DISTANCIA			
TIME1 	EQU 	0X21	;VARIAVLES PARA 
TIME2	EQU		0X22	;HACER USO DE 
TIME3	EQU		0X23	;LAS SUVRUTINAS

; DECLARACIÓN DE REGISTRO 

STATUS	EQU		0X03
PORTA	EQU		0X05
PORTB	EQU		0X06
PORTC	EQU		0X07
TRISA	EQU		0X85
TRISB	EQU		0X86
TRISC	EQU		0X87	
ANSELH	EQU		0X189
ANSEL	EQU		0X188
		ORG		0X00



		GOTO	INI
		ORG		0X20
INI		
		CALL	_4SEG
		CLRF	DIS				;SE LIMPIA LA VARIAVLE DE LA DISTANCIA
		CLRF	CONT			;SE LIMPIA LA VARIAVLE CONTADOR
		BSF		STATUS,RP0		;CAMBIAR AL BANCO 1	
		MOVLW	b'00000010'		;DECLARAR ENTRADAS Y SALIDAS 
		MOVWF	TRISC			;ENTRADA PIN1 DEL TRISC, LAS DEMAS COMO SALIDA
		CLRF	TRISA
		CLRF	TRISB
		BSF		STATUS,RP1		;CAMBIAR AL BANCO 3
		CLRF	ANSELH			;CONFIGURA COMO DIGITAL
		CLRF	ANSEL
		BCF		STATUS,RP0
		BCF		STATUS,RP1
		CLRF	PORTC
;************************************************************
;AQUI COMIENZA LA SECUENCIA DEL PROGRAMA
;************************************************************

COMIENZA
;****************************
;INICIALIZAR SERVO AL CENTRO

		MOVLW	d'1'
		MOVWF	0X40
REG
		BSF		PORTC,SM
		CALL	_CENTRO
		BCF		PORTC,SM
		CALL	_TD
		DECFSZ	0X40
		GOTO	REG
		
		MOVLW	d'10'			;VALOR DE LOS CENTIMETROS, EN ESTE CASO 10CM
		MOVWF	DIS				;MOVERLO A LA VARIABLE DIS
		CLRF	CONT			;LIMPIAR EL CONTADOR
		
;*******************************
;COMIENZA A ANDAR EL CARRO
;********************************
		BCF		PORTC,M1P1		;AVANZA HACIA ADELANTE MOTOR1
		BSF		PORTC,M1P2
		BCF		PORTC,M2P1		;AVANZA HACIA ADELANE MOTOR 2
		BSF		PORTC,M2P2	
;********************************
;LLAMA A MEDIR LA DISTANCIA
;********************************
		CALL	_MEDIR
		
;*******************************
;LLAMA A DECIDIR
;******************************		
		CALL	_DECIDE
		
;*******************************************
;EN ESTA PARTE INCLUIMOS LAS LIVRERIAS
;QUE OCUPAREMOS:
;PARA LOS RETARDOS DE TIEMPO
;PARA MEDIR LA DISTANCIA
;PARA REALIZAR LOS MOVIENTOS DEL CARRITO 
;******************************************		
#INCLUDE<RETARDOS.INC>
#INCLUDE<MEDIR.INC>
#INCLUDE<MOVIMIENTO.INC>
#INCLUDE<LCD.INC>
;ETIQUETA DE FINALIZACIÓN DEL PROGRAMA
		
END