;****************************************************
;*****************************************************
;			SUBRUTINAS PARA MOVIMIENTO
;TANTO DEL SERVO QUE MUEVE EL SENSOR COMO, EL CARRITO 
;*****************************************************
;*****************************************************
CBLOCK

ENDC
;*********************************************
;AQUÍ LOS MOTORES SE DETIENEN, EL SERVO MOTOR
;GIRA A LA IZQUIERDA Y LLAMA A MEDIR. SÍ LA 
;DISTANCIA ES MENOR A 10, LLAMA A GIRAR EL
;SERVO A LA DERECHA Y MEDIR SINO, POSICIONA EL
;SERVO AL CENTRO Y CARRITO GIRA A LA IZQUIERDA
;*********************************************
_M_OFF_SM_L

		BCF		PORTC,M1P1		;APAGA MOTOR1
		BCF		PORTC,M1P2
		BCF		PORTC,M2P1		;APAGA MOTOR2
		BCF		PORTC,M2P2

_M_OFF_SM_L1	
		MOVLW	d'10'
		MOVWF	0X40
AQUI
		BSF		PORTC,SM
		CALL	_IZQ
		BCF		PORTC,SM
		CALL	_TD
		DECFSZ	0X40
		GOTO	AQUI
		
		CALL	_300ML
		
		
		CALL	_MEDIR			;LLAMA A MEDIR
								;MIDE Y RETORNA
		BTFSC	STATUS,0		;CHECA EL CARRY
		CALL	_SM_R			;SI ES 1, LLAMA A MOVER EL SERVOMOTOR A LA DERECHA
		;GOTO	COMIENZA
		CALL	_SM_C_ML		;SI ES 0, LLAMA A MOVER EL SERVOMOTOR AL CENTRO Y MOVER EL CARRITO
								;A LA IZQUIERDA
RETURN

;*********************************************
;AQUÍ LOS MOTORES SE DETIENEN, EL SERVO MOTOR
;GIRA A LA DERECHA Y LLAMA A MEDIR. SI HAY UNA
;DISTANCIA MENOR A 10, LLAMA A PONER EL SERVO 
;AL CENTRO Y A RETROCEDER. SINO, LLAMA A PONER 
;EL SERVO AL CENTRO Y GIRAR EL CAARRITO A LA 
;DERECHA.
;*********************************************

_SM_R
		MOVLW	d'30'
		MOVWF	0X40
AQUI1
		BSF		PORTC,SM
		CALL	_DER
		BCF		PORTC,SM
		CALL	_TD
		DECFSZ	0X40
		GOTO	AQUI1
		
		CALL	_300ML
		
		;GOTO	COMIENZA
		CALL	_MEDIR			;MIDE LA DISTANCIA
		
		BTFSC	STATUS,0		;CHECA EL CARRY
		CALL	_SM_C_RET		;SI ES 1, MUEVE EL SERVO AL CENTRO Y RETROCEDE POR 2 SEGUNDOS
		;GOTO	COMIENZA
		CALL	_SM_C_MR		;SI ES 0, MUEVE EL SERVO AL CENTRO Y MUEVE EL CARRITO A LA DERECHA
RETURN

;*********************************************
;AQUI EL SERVO GIRA AL CENTRO Y EL CARRITO GIRA 
;A LA DERECHA Y LLAMA A MEDIR
;*********************************************

_SM_C_MR
		MOVLW	d'5'
		MOVWF	0X40
AQUI2
		BSF		PORTC,SM
		CALL	_CENTRO
		BCF		PORTC,SM
		CALL	_TD
		DECFSZ	0X40
		GOTO	AQUI2
		
		BCF		PORTC,M1P1		;MOTOR1 ON, Y MOTOR2 OFF. 
		BSF		PORTC,M1P2		;ESTO HARA QUE EL CARRITO SE 
		BCF		PORTC,M2P1		;POSICIONE DEL LADO DERECHO
		BCF		PORTC,M2P2		; :)
	;	CALL	_MOV			;RETARDO DE 2 SEGUNDOS
		CALL	_MOV
		
		
		BCF		PORTC,M1P2		;APAGA MOTOR1

		GOTO	COMIENZA		;COMIENZA DE NUEVO EL PROGRAMA
RETURN

;*********************************************
;AQUÍ EL SERVO GIRA AL CENTRO Y EL CARRITO
;RETROCEDERA 
;*********************************************

_SM_C_RET
		
		MOVLW	d'5'
		MOVWF	0X40
AQUI3
		BSF		PORTC,SM
		CALL	_CENTRO
		BCF		PORTC,SM
		CALL	_TD
		DECFSZ	0X40
		GOTO	AQUI3
	
	;	CALL	_2SEG
		BSF		PORTC,M1P1		;MOTOR1 Y MOTOR2 GIRAN 
		BCF		PORTC,M1P2		;EN SENTIDO CONTRARIO
		BSF		PORTC,M2P1		
		BCF		PORTC,M2P2
		
		CALL	_4SEG			;RETARDO DE 2 SEGUNDOS
		CLRF	PORTC
		CALL	_M_OFF_SM_L1		;LLAMA A VOLVER A GIRAR EL SERVO A LA IZQUIERDA
;(EN ESTE PUNTO VUELVE A COMENZAR LA LOGICA PERO EL CARRITO YA SE ENCUENTA EN OTRA POSICION)
RETURN

;*********************************************
;AQUÍ EL SERVO GIRA AL CENTRO Y EL CARRITO
;GIRA A LA DERECHA.
;*********************************************

_SM_C_ML
		
		MOVLW	d'5'
		MOVWF	0X40
AQUI4
		BSF		PORTC,SM
		CALL	_CENTRO
		BCF		PORTC,SM
		CALL	_TD
		DECFSZ	0X40
		GOTO	AQUI4
		
;		CALL	_2SEG
		BCF		PORTC,M1P1		;APAGA MOTOR1 OFF Y MOTOR2 ON
		BCF		PORTC,M1P2		;ESTO HARA QUE EL CARRITO SE 
		BCF		PORTC,M2P1		;POSICIONE DEL LADO IZQUIERDO
		BSF		PORTC,M2P2		; <3
		
		CALL	_MOV			;RETARDO DE 2 SEGUNDOS
			
		BCF		PORTC,M2P2		;DETIENE EL MOTOR

		GOTO	COMIENZA		;COMIENZA DE NUEVO LA LOGICA DEL PROGRAMA
RETURN